## data/toybox/models/2006/2006-10-31_23-30-06/kconfig.kmax
```kconfig
config CONFIG_CONFIG_TOYSH_TTY bool
prompt CONFIG_CONFIG_TOYSH_TTY (CONFIG_CONFIG_TOYSH)
def_bool CONFIG_CONFIG_TOYSH_TTY 0 (CONFIG_CONFIG_TOYSH)
config CONFIG_CONFIG_TOYSH_ENVVARS bool
prompt CONFIG_CONFIG_TOYSH_ENVVARS (CONFIG_CONFIG_TOYSH_QUOTES)
def_bool CONFIG_CONFIG_TOYSH_ENVVARS 0 (CONFIG_CONFIG_TOYSH_QUOTES)
config CONFIG_CONFIG_TOYSH_WILDCARDS bool
prompt CONFIG_CONFIG_TOYSH_WILDCARDS (CONFIG_CONFIG_TOYSH_QUOTES)
def_bool CONFIG_CONFIG_TOYSH_WILDCARDS 0 (CONFIG_CONFIG_TOYSH_QUOTES)
config CONFIG_CONFIG_TOYSH_FLOWCTL bool
prompt CONFIG_CONFIG_TOYSH_FLOWCTL (CONFIG_CONFIG_TOYSH)
def_bool CONFIG_CONFIG_TOYSH_FLOWCTL 0 (CONFIG_CONFIG_TOYSH)
config CONFIG_CONFIG_TOYSH_JOBCTL bool
prompt CONFIG_CONFIG_TOYSH_JOBCTL (CONFIG_CONFIG_TOYSH_TTY)
def_bool CONFIG_CONFIG_TOYSH_JOBCTL 0 (CONFIG_CONFIG_TOYSH_TTY)
config CONFIG_CONFIG_TOYS_FREE bool
prompt CONFIG_CONFIG_TOYS_FREE (1)
def_bool CONFIG_CONFIG_TOYS_FREE 0 (1)
config CONFIG_CONFIG_TOYSH_ARRAYS bool
prompt CONFIG_CONFIG_TOYSH_ARRAYS (CONFIG_CONFIG_TOYSH_LOCALS)
def_bool CONFIG_CONFIG_TOYSH_ARRAYS 0 (CONFIG_CONFIG_TOYSH_LOCALS)
config CONFIG_CONFIG_TOYSH_PIPES bool
prompt CONFIG_CONFIG_TOYSH_PIPES (CONFIG_CONFIG_TOYSH)
def_bool CONFIG_CONFIG_TOYSH_PIPES 0 (CONFIG_CONFIG_TOYSH)
config CONFIG_CONFIG_TOYSH_BUILTINS bool
prompt CONFIG_CONFIG_TOYSH_BUILTINS (CONFIG_CONFIG_TOYSH)
def_bool CONFIG_CONFIG_TOYSH_BUILTINS 0 (CONFIG_CONFIG_TOYSH)
config CONFIG_CONFIG_TOYSH_PROCARGS bool
prompt CONFIG_CONFIG_TOYSH_PROCARGS (CONFIG_CONFIG_TOYSH_QUOTES)
def_bool CONFIG_CONFIG_TOYSH_PROCARGS 0 (CONFIG_CONFIG_TOYSH_QUOTES)
config CONFIG_CONFIG_DF bool
prompt CONFIG_CONFIG_DF (1)
def_bool CONFIG_CONFIG_DF 0 (1)
config CONFIG_CONFIG_TOYSH_QUOTES bool
prompt CONFIG_CONFIG_TOYSH_QUOTES (CONFIG_CONFIG_TOYSH)
def_bool CONFIG_CONFIG_TOYSH_QUOTES 0 (CONFIG_CONFIG_TOYSH)
config CONFIG_CONFIG_TOYSH_PROFILE bool
prompt CONFIG_CONFIG_TOYSH_PROFILE (CONFIG_CONFIG_TOYSH_TTY)
def_bool CONFIG_CONFIG_TOYSH_PROFILE 0 (CONFIG_CONFIG_TOYSH_TTY)
config CONFIG_CONFIG_TOYSH bool
prompt CONFIG_CONFIG_TOYSH (1)
def_bool CONFIG_CONFIG_TOYSH 0 (1)
config CONFIG_CONFIG_DF_PEDANTIC bool
prompt CONFIG_CONFIG_DF_PEDANTIC (CONFIG_CONFIG_DF)
def_bool CONFIG_CONFIG_DF_PEDANTIC 0 (CONFIG_CONFIG_DF)
config CONFIG_CONFIG_TOYSH_LOCALS bool
prompt CONFIG_CONFIG_TOYSH_LOCALS (CONFIG_CONFIG_TOYSH_ENVVARS)
def_bool CONFIG_CONFIG_TOYSH_LOCALS 0 (CONFIG_CONFIG_TOYSH_ENVVARS)
dep CONFIG_CONFIG_TOYSH_TTY (CONFIG_CONFIG_TOYSH)
dep CONFIG_CONFIG_TOYSH_ENVVARS (CONFIG_CONFIG_TOYSH_QUOTES)
dep CONFIG_CONFIG_TOYSH_WILDCARDS (CONFIG_CONFIG_TOYSH_QUOTES)
dep CONFIG_CONFIG_TOYSH_FLOWCTL (CONFIG_CONFIG_TOYSH)
dep CONFIG_CONFIG_TOYSH_JOBCTL (CONFIG_CONFIG_TOYSH_TTY)
dep CONFIG_CONFIG_TOYSH_ARRAYS (CONFIG_CONFIG_TOYSH_LOCALS)
dep CONFIG_CONFIG_TOYSH_PIPES (CONFIG_CONFIG_TOYSH)
dep CONFIG_CONFIG_TOYSH_BUILTINS (CONFIG_CONFIG_TOYSH)
dep CONFIG_CONFIG_TOYSH_PROCARGS (CONFIG_CONFIG_TOYSH_QUOTES)
dep CONFIG_CONFIG_TOYSH_QUOTES (CONFIG_CONFIG_TOYSH)
dep CONFIG_CONFIG_TOYSH_PROFILE (CONFIG_CONFIG_TOYSH_TTY)
dep CONFIG_CONFIG_DF_PEDANTIC (CONFIG_CONFIG_DF)
dep CONFIG_CONFIG_TOYSH_LOCALS (CONFIG_CONFIG_TOYSH_ENVVARS)
```

## data/toybox/models/2006/2006-11-02_11-20-53/kconfig.kmax
```kconfig
config CONFIG_TOYSH_PROFILE bool
prompt CONFIG_TOYSH_PROFILE (CONFIG_TOYSH_TTY)
def_bool CONFIG_TOYSH_PROFILE 0 (CONFIG_TOYSH_TTY)
config CONFIG_TOYSH_JOBCTL bool
prompt CONFIG_TOYSH_JOBCTL (CONFIG_TOYSH_TTY)
def_bool CONFIG_TOYSH_JOBCTL 0 (CONFIG_TOYSH_TTY)
config CONFIG_TOYS_FREE bool
prompt CONFIG_TOYS_FREE (1)
def_bool CONFIG_TOYS_FREE 0 (1)
config CONFIG_DF bool
prompt CONFIG_DF (1)
def_bool CONFIG_DF 0 (1)
config CONFIG_DF_PEDANTIC bool
prompt CONFIG_DF_PEDANTIC (CONFIG_DF)
def_bool CONFIG_DF_PEDANTIC 0 (CONFIG_DF)
config CONFIG_TOYSH_WILDCARDS bool
prompt CONFIG_TOYSH_WILDCARDS (CONFIG_TOYSH_QUOTES)
def_bool CONFIG_TOYSH_WILDCARDS 0 (CONFIG_TOYSH_QUOTES)
config CONFIG_TOYSH_PIPES bool
prompt CONFIG_TOYSH_PIPES (CONFIG_TOYSH)
def_bool CONFIG_TOYSH_PIPES 0 (CONFIG_TOYSH)
config CONFIG_TOYSH_BUILTINS bool
prompt CONFIG_TOYSH_BUILTINS (CONFIG_TOYSH)
def_bool CONFIG_TOYSH_BUILTINS 0 (CONFIG_TOYSH)
config CONFIG_TOYSH_ARRAYS bool
prompt CONFIG_TOYSH_ARRAYS (CONFIG_TOYSH_LOCALS)
def_bool CONFIG_TOYSH_ARRAYS 0 (CONFIG_TOYSH_LOCALS)
config CONFIG_TOYSH_QUOTES bool
prompt CONFIG_TOYSH_QUOTES (CONFIG_TOYSH)
def_bool CONFIG_TOYSH_QUOTES 0 (CONFIG_TOYSH)
config CONFIG_TOYSH_LOCALS bool
prompt CONFIG_TOYSH_LOCALS (CONFIG_TOYSH_ENVVARS)
def_bool CONFIG_TOYSH_LOCALS 0 (CONFIG_TOYSH_ENVVARS)
config CONFIG_TOYSH_ENVVARS bool
prompt CONFIG_TOYSH_ENVVARS (CONFIG_TOYSH_QUOTES)
def_bool CONFIG_TOYSH_ENVVARS 0 (CONFIG_TOYSH_QUOTES)
config CONFIG_TOYSH bool
prompt CONFIG_TOYSH (1)
def_bool CONFIG_TOYSH 0 (1)
config CONFIG_TOYSH_FLOWCTL bool
prompt CONFIG_TOYSH_FLOWCTL (CONFIG_TOYSH)
def_bool CONFIG_TOYSH_FLOWCTL 0 (CONFIG_TOYSH)
config CONFIG_TOYSH_TTY bool
prompt CONFIG_TOYSH_TTY (CONFIG_TOYSH)
def_bool CONFIG_TOYSH_TTY 0 (CONFIG_TOYSH)
config CONFIG_TOYSH_PROCARGS bool
prompt CONFIG_TOYSH_PROCARGS (CONFIG_TOYSH_QUOTES)
def_bool CONFIG_TOYSH_PROCARGS 0 (CONFIG_TOYSH_QUOTES)
dep CONFIG_TOYSH_PROFILE (CONFIG_TOYSH_TTY)
dep CONFIG_TOYSH_JOBCTL (CONFIG_TOYSH_TTY)
dep CONFIG_DF_PEDANTIC (CONFIG_DF)
dep CONFIG_TOYSH_WILDCARDS (CONFIG_TOYSH_QUOTES)
dep CONFIG_TOYSH_PIPES (CONFIG_TOYSH)
dep CONFIG_TOYSH_BUILTINS (CONFIG_TOYSH)
dep CONFIG_TOYSH_ARRAYS (CONFIG_TOYSH_LOCALS)
dep CONFIG_TOYSH_QUOTES (CONFIG_TOYSH)
dep CONFIG_TOYSH_LOCALS (CONFIG_TOYSH_ENVVARS)
dep CONFIG_TOYSH_ENVVARS (CONFIG_TOYSH_QUOTES)
dep CONFIG_TOYSH_FLOWCTL (CONFIG_TOYSH)
dep CONFIG_TOYSH_TTY (CONFIG_TOYSH)
dep CONFIG_TOYSH_PROCARGS (CONFIG_TOYSH_QUOTES)
```

## data/toybox/models/2007/2007-06-18_00-44-53/kconfig.kmax
```kconfig
config CONFIG_WHICH bool
prompt CONFIG_WHICH (1)
def_bool CONFIG_WHICH 1 (1)
config CONFIG_TOYSH_PROFILE bool
prompt CONFIG_TOYSH_PROFILE (CONFIG_TOYSH_TTY)
def_bool CONFIG_TOYSH_PROFILE 0 (CONFIG_TOYSH_TTY)
config CONFIG_CATV bool
prompt CONFIG_CATV (1)
def_bool CONFIG_CATV 1 (1)
config CONFIG_MDEV_CONF bool
prompt CONFIG_MDEV_CONF (1)
def_bool CONFIG_MDEV_CONF 0 (1)
config CONFIG_TOYSH_JOBCTL bool
prompt CONFIG_TOYSH_JOBCTL (CONFIG_TOYSH_TTY)
def_bool CONFIG_TOYSH_JOBCTL 0 (CONFIG_TOYSH_TTY)
config CONFIG_SYNC bool
prompt CONFIG_SYNC (1)
def_bool CONFIG_SYNC 1 (1)
config CONFIG_READLINK bool
prompt CONFIG_READLINK (1)
def_bool CONFIG_READLINK 0 (1)
config CONFIG_DF bool
prompt CONFIG_DF (1)
def_bool CONFIG_DF 1 (1)
config CONFIG_DF_PEDANTIC bool
prompt CONFIG_DF_PEDANTIC (CONFIG_DF)
def_bool CONFIG_DF_PEDANTIC 1 (CONFIG_DF)
config CONFIG_BZCAT bool
prompt CONFIG_BZCAT (1)
def_bool CONFIG_BZCAT 0 (1)
config CONFIG_YES bool
prompt CONFIG_YES (1)
def_bool CONFIG_YES 1 (1)
config CONFIG_TOYSH_WILDCARDS bool
prompt CONFIG_TOYSH_WILDCARDS (CONFIG_TOYSH_QUOTES)
def_bool CONFIG_TOYSH_WILDCARDS 0 (CONFIG_TOYSH_QUOTES)
config CONFIG_TOYSH_PIPES bool
prompt CONFIG_TOYSH_PIPES (CONFIG_TOYSH)
def_bool CONFIG_TOYSH_PIPES 0 (CONFIG_TOYSH)
config CONFIG_MKE2FS_EXTENDED bool
prompt CONFIG_MKE2FS_EXTENDED (CONFIG_MKE2FS)
def_bool CONFIG_MKE2FS_EXTENDED 0 (CONFIG_MKE2FS)
config CONFIG_MKE2FS bool
prompt CONFIG_MKE2FS (1)
def_bool CONFIG_MKE2FS 0 (1)
config CONFIG_TOYBOX_FREE bool
prompt CONFIG_TOYBOX_FREE (1)
def_bool CONFIG_TOYBOX_FREE 0 (1)
config CONFIG_TOYSH_BUILTINS bool
prompt CONFIG_TOYSH_BUILTINS (CONFIG_TOYSH)
def_bool CONFIG_TOYSH_BUILTINS 0 (CONFIG_TOYSH)
config CONFIG_SLEEP bool
prompt CONFIG_SLEEP (1)
def_bool CONFIG_SLEEP 1 (1)
config CONFIG_TOYBOX_DEBUG bool
prompt CONFIG_TOYBOX_DEBUG (1)
def_bool CONFIG_TOYBOX_DEBUG 0 (1)
config CONFIG_TOYSH_ARRAYS bool
prompt CONFIG_TOYSH_ARRAYS (CONFIG_TOYSH_LOCALS)
def_bool CONFIG_TOYSH_ARRAYS 0 (CONFIG_TOYSH_LOCALS)
config CONFIG_PWD bool
prompt CONFIG_PWD (1)
def_bool CONFIG_PWD 1 (1)
config CONFIG_ONEIT bool
prompt CONFIG_ONEIT (1)
def_bool CONFIG_ONEIT 1 (1)
config CONFIG_TOYSH_QUOTES bool
prompt CONFIG_TOYSH_QUOTES (CONFIG_TOYSH)
def_bool CONFIG_TOYSH_QUOTES 0 (CONFIG_TOYSH)
config CONFIG_MKE2FS_JOURNAL bool
prompt CONFIG_MKE2FS_JOURNAL (CONFIG_MKE2FS)
def_bool CONFIG_MKE2FS_JOURNAL 0 (CONFIG_MKE2FS)
config CONFIG_MKE2FS_LABEL bool
prompt CONFIG_MKE2FS_LABEL (CONFIG_MKE2FS)
def_bool CONFIG_MKE2FS_LABEL 0 (CONFIG_MKE2FS)
config CONFIG_HELLO bool
prompt CONFIG_HELLO (1)
def_bool CONFIG_HELLO 1 (1)
config CONFIG_COUNT bool
prompt CONFIG_COUNT (1)
def_bool CONFIG_COUNT 1 (1)
config CONFIG_FALSE bool
prompt CONFIG_FALSE (1)
def_bool CONFIG_FALSE 1 (1)
config CONFIG_TOYSH_LOCALS bool
prompt CONFIG_TOYSH_LOCALS (CONFIG_TOYSH_ENVVARS)
def_bool CONFIG_TOYSH_LOCALS 0 (CONFIG_TOYSH_ENVVARS)
config CONFIG_TOYSH_ENVVARS bool
prompt CONFIG_TOYSH_ENVVARS (CONFIG_TOYSH_QUOTES)
def_bool CONFIG_TOYSH_ENVVARS 0 (CONFIG_TOYSH_QUOTES)
config CONFIG_ECHO bool
prompt CONFIG_ECHO (1)
def_bool CONFIG_ECHO 1 (1)
config CONFIG_TRUE bool
prompt CONFIG_TRUE (1)
def_bool CONFIG_TRUE 1 (1)
config CONFIG_MDEV bool
prompt CONFIG_MDEV (1)
def_bool CONFIG_MDEV 0 (1)
config CONFIG_READLINK_F bool
prompt CONFIG_READLINK_F (CONFIG_READLINK_F)
def_bool CONFIG_READLINK_F 0 (CONFIG_READLINK_F)
config CONFIG_TOYSH bool
prompt CONFIG_TOYSH (1)
def_bool CONFIG_TOYSH 1 (1)
config CONFIG_TOYSH_FLOWCTL bool
prompt CONFIG_TOYSH_FLOWCTL (CONFIG_TOYSH)
def_bool CONFIG_TOYSH_FLOWCTL 0 (CONFIG_TOYSH)
config CONFIG_MKE2FS_GEN bool
prompt CONFIG_MKE2FS_GEN (CONFIG_MKE2FS)
def_bool CONFIG_MKE2FS_GEN 0 (CONFIG_MKE2FS)
config CONFIG_TOYSH_TTY bool
prompt CONFIG_TOYSH_TTY (CONFIG_TOYSH)
def_bool CONFIG_TOYSH_TTY 0 (CONFIG_TOYSH)
config CONFIG_TOUCH bool
prompt CONFIG_TOUCH (1)
def_bool CONFIG_TOUCH 0 (1)
config CONFIG_TOYSH_PROCARGS bool
prompt CONFIG_TOYSH_PROCARGS (CONFIG_TOYSH_QUOTES)
def_bool CONFIG_TOYSH_PROCARGS 0 (CONFIG_TOYSH_QUOTES)
dep CONFIG_TOYSH_PROFILE (CONFIG_TOYSH_TTY)
dep CONFIG_TOYSH_JOBCTL (CONFIG_TOYSH_TTY)
dep CONFIG_DF_PEDANTIC (CONFIG_DF)
dep CONFIG_TOYSH_WILDCARDS (CONFIG_TOYSH_QUOTES)
dep CONFIG_TOYSH_PIPES (CONFIG_TOYSH)
dep CONFIG_MKE2FS_EXTENDED (CONFIG_MKE2FS)
dep CONFIG_TOYSH_BUILTINS (CONFIG_TOYSH)
dep CONFIG_TOYSH_ARRAYS (CONFIG_TOYSH_LOCALS)
dep CONFIG_TOYSH_QUOTES (CONFIG_TOYSH)
dep CONFIG_MKE2FS_JOURNAL (CONFIG_MKE2FS)
dep CONFIG_MKE2FS_LABEL (CONFIG_MKE2FS)
dep CONFIG_TOYSH_LOCALS (CONFIG_TOYSH_ENVVARS)
dep CONFIG_TOYSH_ENVVARS (CONFIG_TOYSH_QUOTES)
dep CONFIG_READLINK_F (CONFIG_READLINK_F)
dep CONFIG_TOYSH_FLOWCTL (CONFIG_TOYSH)
dep CONFIG_MKE2FS_GEN (CONFIG_MKE2FS)
dep CONFIG_TOYSH_TTY (CONFIG_TOYSH)
dep CONFIG_TOYSH_PROCARGS (CONFIG_TOYSH_QUOTES)
```
