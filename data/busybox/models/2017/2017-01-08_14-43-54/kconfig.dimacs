## data/soletta/models/2015/2015-06-29_16-17-30/kconfig.kmax
```kconfig
config CONFIG_DEFAULT_LOG_LEVEL_CRITICAL bool
prompt CONFIG_DEFAULT_LOG_LEVEL_CRITICAL (1)
config CONFIG_HAVE_CHECK bool
def_bool CONFIG_HAVE_CHECK 0 (1)
config CONFIG_LINUX_MICRO_BLUETOOTH bool
prompt CONFIG_LINUX_MICRO_BLUETOOTH (CONFIG_LINUX_MICRO)
def_bool CONFIG_LINUX_MICRO_BLUETOOTH 0 (CONFIG_LINUX_MICRO)
config CONFIG_FLOW_NODE_TYPE_CONVERTER bool
prompt CONFIG_FLOW_NODE_TYPE_CONVERTER (CONFIG_FLOW)
def_bool CONFIG_FLOW_NODE_TYPE_CONVERTER 1 (CONFIG_FLOW)
config CONFIG_KDBUS bool
prompt CONFIG_KDBUS ((CONFIG_PLATFORM_LINUX_MICRO or CONFIG_PLATFORM_SYSTEMD) and CONFIG_HAVE_SYSTEMD and CONFIG_HAVE_KDBUS)
def_bool CONFIG_KDBUS 0 ((CONFIG_PLATFORM_LINUX_MICRO or CONFIG_PLATFORM_SYSTEMD) and CONFIG_HAVE_SYSTEMD and CONFIG_HAVE_KDBUS)
config CONFIG_HAVE_RIOTOS bool
def_bool CONFIG_HAVE_RIOTOS 0 (1)
config CONFIG_FLOW_NODE_TYPE_UDEV bool
prompt CONFIG_FLOW_NODE_TYPE_UDEV (CONFIG_FLOW)
def_bool CONFIG_FLOW_NODE_TYPE_UDEV 1 (CONFIG_FLOW)
config CONFIG_HAVE_STRINGS_H bool
def_bool CONFIG_HAVE_STRINGS_H 0 (1)
config CONFIG_HAVE_GTK bool
def_bool CONFIG_HAVE_GTK 0 (1)
config CONFIG_HAVE_DLFCN_H bool
def_bool CONFIG_HAVE_DLFCN_H 0 (1)
config CONFIG_MAINLOOP_RIOTOS bool
prompt CONFIG_MAINLOOP_RIOTOS (1 and CONFIG_PLATFORM_RIOTOS and CONFIG_HAVE_RIOTOS)
config CONFIG_HAVE_PPOLL bool
def_bool CONFIG_HAVE_PPOLL 0 (1)
config CONFIG_HAVE_MEMORY_H bool
def_bool CONFIG_HAVE_MEMORY_H 0 (1)
config CONFIG_FLOW_NODE_TYPE_APP bool
prompt CONFIG_FLOW_NODE_TYPE_APP (CONFIG_FLOW)
def_bool CONFIG_FLOW_NODE_TYPE_APP 1 (CONFIG_FLOW)
config CONFIG_HAVE_STDLIB_H bool
def_bool CONFIG_HAVE_STDLIB_H 0 (1)
config CONFIG_FLOW_NODE_TYPE_FLOAT bool
prompt CONFIG_FLOW_NODE_TYPE_FLOAT (CONFIG_FLOW)
def_bool CONFIG_FLOW_NODE_TYPE_FLOAT 1 (CONFIG_FLOW)
config CONFIG_FLOW_NODE_TYPE_NETWORK bool
prompt CONFIG_FLOW_NODE_TYPE_NETWORK (CONFIG_FLOW)
def_bool CONFIG_FLOW_NODE_TYPE_NETWORK 1 (CONFIG_FLOW)
config CONFIG_LINUX_MICRO_HOSTNAME bool
prompt CONFIG_LINUX_MICRO_HOSTNAME (CONFIG_LINUX_MICRO)
def_bool CONFIG_LINUX_MICRO_HOSTNAME 0 (CONFIG_LINUX_MICRO)
config CONFIG_FLOW_NODE_TYPE_KEYBOARD bool
prompt CONFIG_FLOW_NODE_TYPE_KEYBOARD (CONFIG_FLOW)
def_bool CONFIG_FLOW_NODE_TYPE_KEYBOARD 1 (CONFIG_FLOW)
config CONFIG_SOCKET_LINUX bool
prompt CONFIG_SOCKET_LINUX (CONFIG_PLATFORM_LINUX_MICRO or CONFIG_PLATFORM_SYSTEMD)
def_bool CONFIG_SOCKET_LINUX 1 (CONFIG_PLATFORM_LINUX_MICRO or CONFIG_PLATFORM_SYSTEMD)
config CONFIG_LINUX_MICRO_FSTAB bool
prompt CONFIG_LINUX_MICRO_FSTAB (CONFIG_LINUX_MICRO)
def_bool CONFIG_LINUX_MICRO_FSTAB 0 (CONFIG_LINUX_MICRO)
config CONFIG_FLOW_NODE_TYPE_ACCELEROMETER bool
prompt CONFIG_FLOW_NODE_TYPE_ACCELEROMETER (CONFIG_FLOW and CONFIG_SOL_PLATFORM_LINUX)
def_bool CONFIG_FLOW_NODE_TYPE_ACCELEROMETER 1 (CONFIG_FLOW and CONFIG_SOL_PLATFORM_LINUX)
config CONFIG_TEST_ARENA bool
prompt CONFIG_TEST_ARENA (1)
def_bool CONFIG_TEST_ARENA 1 (1)
config CONFIG_TEST_BUFFER bool
prompt CONFIG_TEST_BUFFER (1)
def_bool CONFIG_TEST_BUFFER 1 (1)
config CONFIG_HAVE_ISATTY bool
def_bool CONFIG_HAVE_ISATTY 0 (1)
config CONFIG_FLOW_NODE_TYPE_TEST bool
prompt CONFIG_FLOW_NODE_TYPE_TEST (CONFIG_FLOW)
def_bool CONFIG_FLOW_NODE_TYPE_TEST 1 (CONFIG_FLOW)
config CONFIG_USE_GLIB bool
def_bool CONFIG_USE_GLIB 0 (1)
config CONFIG_TEST_MAINLOOP_THREADS_SOL_RUN bool
prompt CONFIG_TEST_MAINLOOP_THREADS_SOL_RUN (CONFIG_PTHREAD)
def_bool CONFIG_TEST_MAINLOOP_THREADS_SOL_RUN 0 (CONFIG_PTHREAD)
config CONFIG_PLATFORM_RIOTOS bool
prompt CONFIG_PLATFORM_RIOTOS (1)
config CONFIG_HAVE_INTTYPES_H bool
def_bool CONFIG_HAVE_INTTYPES_H 0 (1)
config CONFIG_MAINLOOP_POSIX bool
prompt CONFIG_MAINLOOP_POSIX (1 and (CONFIG_PLATFORM_LINUX_MICRO or CONFIG_PLATFORM_SYSTEMD))
config CONFIG_TEST_MAINLOOP_THREADS bool
prompt CONFIG_TEST_MAINLOOP_THREADS (CONFIG_PTHREAD)
def_bool CONFIG_TEST_MAINLOOP_THREADS 1 (CONFIG_PTHREAD)
config CONFIG_FLOW_NODE_TYPE_GTK bool
prompt CONFIG_FLOW_NODE_TYPE_GTK (CONFIG_FLOW and CONFIG_HAVE_GTK)
def_bool CONFIG_FLOW_NODE_TYPE_GTK 1 (CONFIG_FLOW and CONFIG_HAVE_GTK)
config CONFIG_LINUX_MICRO_LOCALE bool
prompt CONFIG_LINUX_MICRO_LOCALE (CONFIG_LINUX_MICRO)
def_bool CONFIG_LINUX_MICRO_LOCALE 0 (CONFIG_LINUX_MICRO)
config CONFIG_LINUX_MICRO bool
prompt CONFIG_LINUX_MICRO (CONFIG_PLATFORM_LINUX_MICRO)
def_bool CONFIG_LINUX_MICRO 0 (CONFIG_PLATFORM_LINUX_MICRO)
config CONFIG_CORE bool
def_bool CONFIG_CORE 1 (1)
config CONFIG_PREFIX string
prompt CONFIG_PREFIX (1)
def_nonbool CONFIG_PREFIX "/usr"|(1)
config CONFIG_INSPECTOR bool
prompt CONFIG_INSPECTOR (1)
def_bool CONFIG_INSPECTOR 1 (1)
config CONFIG_HAVE_UNISTD_H bool
def_bool CONFIG_HAVE_UNISTD_H 0 (1)
config CONFIG_HAVE_LINUX_RTNETLINK_H bool
def_bool CONFIG_HAVE_LINUX_RTNETLINK_H 0 (1)
config CONFIG_TEST_FLOW_PARSER bool
prompt CONFIG_TEST_FLOW_PARSER (1)
def_bool CONFIG_TEST_FLOW_PARSER 1 (1)
config CONFIG_FLOW_NODE_TYPE_FS bool
prompt CONFIG_FLOW_NODE_TYPE_FS (CONFIG_FLOW)
def_bool CONFIG_FLOW_NODE_TYPE_FS 1 (CONFIG_FLOW)
config CONFIG_HAVE_LINUX_NETLINK_H bool
def_bool CONFIG_HAVE_LINUX_NETLINK_H 0 (1)
config CONFIG_FLOW_NODE_TYPE_GPIO bool
prompt CONFIG_FLOW_NODE_TYPE_GPIO (CONFIG_FLOW)
def_bool CONFIG_FLOW_NODE_TYPE_GPIO 1 (CONFIG_FLOW)
config CONFIG_FLOW bool
prompt CONFIG_FLOW (1)
def_bool CONFIG_FLOW 1 (1)
config CONFIG_MODULES bool
prompt CONFIG_MODULES (1)
def_bool CONFIG_MODULES 1 (1)
config CONFIG_LINUX_MICRO_NETWORK_UP bool
prompt CONFIG_LINUX_MICRO_NETWORK_UP (CONFIG_LINUX_MICRO)
def_bool CONFIG_LINUX_MICRO_NETWORK_UP 0 (CONFIG_LINUX_MICRO)
config CONFIG_FLOW_NODE_TYPE_CONSTANT bool
prompt CONFIG_FLOW_NODE_TYPE_CONSTANT (CONFIG_FLOW)
def_bool CONFIG_FLOW_NODE_TYPE_CONSTANT 1 (CONFIG_FLOW)
config CONFIG_USE_SYSTEMD bool
def_bool CONFIG_USE_SYSTEMD 0 (1)
config CONFIG_DEFAULT_LOG_LEVEL_ERROR bool
prompt CONFIG_DEFAULT_LOG_LEVEL_ERROR (1)
config CONFIG_FLOW_NODE_TYPE_RANDOM bool
prompt CONFIG_FLOW_NODE_TYPE_RANDOM (CONFIG_FLOW)
def_bool CONFIG_FLOW_NODE_TYPE_RANDOM 1 (CONFIG_FLOW)
config CONFIG_FLOW_NODE_TYPE_STRING bool
prompt CONFIG_FLOW_NODE_TYPE_STRING (CONFIG_FLOW)
def_bool CONFIG_FLOW_NODE_TYPE_STRING 1 (CONFIG_FLOW)
config CONFIG_HAVE_SYSTEMD bool
def_bool CONFIG_HAVE_SYSTEMD 0 (1)
config CONFIG_FLOW_NODE_TYPE_AIO bool
prompt CONFIG_FLOW_NODE_TYPE_AIO (CONFIG_FLOW)
def_bool CONFIG_FLOW_NODE_TYPE_AIO 1 (CONFIG_FLOW)
config CONFIG_FLOW_NODE_TYPE_TIMER bool
prompt CONFIG_FLOW_NODE_TYPE_TIMER (CONFIG_FLOW)
def_bool CONFIG_FLOW_NODE_TYPE_TIMER 1 (CONFIG_FLOW)
config CONFIG_TEST_MAINLOOP_LINUX bool
prompt CONFIG_TEST_MAINLOOP_LINUX ("PLATFORM_LINUX")
def_bool CONFIG_TEST_MAINLOOP_LINUX 1 ("PLATFORM_LINUX")
config CONFIG_FLOW_NODE_TYPE_CALAMARI bool
prompt CONFIG_FLOW_NODE_TYPE_CALAMARI (CONFIG_FLOW and CONFIG_FLOW_NODE_TYPE_GPIO)
def_bool CONFIG_FLOW_NODE_TYPE_CALAMARI 1 (CONFIG_FLOW and CONFIG_FLOW_NODE_TYPE_GPIO)
config CONFIG_PTHREAD bool
prompt CONFIG_PTHREAD (CONFIG_HAVE_PTHREAD and CONFIG_HAVE_GLIB and (CONFIG_PLATFORM_LINUX_MICRO or CONFIG_PLATFORM_SYSTEMD))
def_bool CONFIG_PTHREAD 1 (CONFIG_HAVE_PTHREAD and CONFIG_HAVE_GLIB and (CONFIG_PLATFORM_LINUX_MICRO or CONFIG_PLATFORM_SYSTEMD))
config CONFIG_FLOW_NODE_TYPE_OIC bool
prompt CONFIG_FLOW_NODE_TYPE_OIC (CONFIG_FLOW and CONFIG_COAP and CONFIG_SOCKET_LINUX)
def_bool CONFIG_FLOW_NODE_TYPE_OIC 1 (CONFIG_FLOW and CONFIG_COAP and CONFIG_SOCKET_LINUX)
config CONFIG_SOL_PLATFORM_LINUX bool
def_bool CONFIG_SOL_PLATFORM_LINUX 0 (1)
config CONFIG_INTERNAL_SHARED bool
def_bool CONFIG_INTERNAL_SHARED 1 (1)
config CONFIG_ENABLE_DYNAMIC_MODULES bool
def_bool CONFIG_ENABLE_DYNAMIC_MODULES 0 (1)
config CONFIG_HAVE_LINUX_WATCHDOG_H bool
def_bool CONFIG_HAVE_LINUX_WATCHDOG_H 0 (1)
config CONFIG_FLOW_NODE_TYPE_PLATFORM bool
prompt CONFIG_FLOW_NODE_TYPE_PLATFORM (CONFIG_FLOW)
def_bool CONFIG_FLOW_NODE_TYPE_PLATFORM 1 (CONFIG_FLOW)
config CONFIG_HAVE_PTHREAD bool
def_bool CONFIG_HAVE_PTHREAD 0 (1)
config CONFIG_FLOW_NODE_TYPE_WALLCLOCK bool
prompt CONFIG_FLOW_NODE_TYPE_WALLCLOCK (CONFIG_FLOW)
def_bool CONFIG_FLOW_NODE_TYPE_WALLCLOCK 1 (CONFIG_FLOW)
config CONFIG_FLOW_NODE_TYPE_HUB bool
prompt CONFIG_FLOW_NODE_TYPE_HUB (CONFIG_FLOW)
def_bool CONFIG_FLOW_NODE_TYPE_HUB 1 (CONFIG_FLOW)
config CONFIG_FLOW_NODE_TYPE_SERVO_MOTOR bool
prompt CONFIG_FLOW_NODE_TYPE_SERVO_MOTOR (CONFIG_FLOW)
def_bool CONFIG_FLOW_NODE_TYPE_SERVO_MOTOR 1 (CONFIG_FLOW)
config CONFIG_DEFAULT_LOG_LEVEL_WARNING bool
prompt CONFIG_DEFAULT_LOG_LEVEL_WARNING (1)
config CONFIG_HAVE_PTHREAD_H bool
def_bool CONFIG_HAVE_PTHREAD_H 0 (1)
config CONFIG_FLOW_NODE_TYPES bool
prompt CONFIG_FLOW_NODE_TYPES (CONFIG_SOCKET_LINUX and CONFIG_RESOLVER_CONFFILE and CONFIG_INSPECTOR)
def_bool CONFIG_FLOW_NODE_TYPES 1 (CONFIG_SOCKET_LINUX and CONFIG_RESOLVER_CONFFILE and CONFIG_INSPECTOR)
config CONFIG_HAVE_SYS_TYPES_H bool
def_bool CONFIG_HAVE_SYS_TYPES_H 0 (1)
config CONFIG_USE_UDEV bool
def_bool CONFIG_USE_UDEV 0 (1)
config CONFIG_TEST_FLOW bool
prompt CONFIG_TEST_FLOW (1)
def_bool CONFIG_TEST_FLOW 1 (1)
config CONFIG_TEST_FBP bool
prompt CONFIG_TEST_FBP (1)
def_bool CONFIG_TEST_FBP 1 (1)
config CONFIG_PLATFORM_DUMMY bool
prompt CONFIG_PLATFORM_DUMMY (1)
config CONFIG_TEST_VECTOR bool
prompt CONFIG_TEST_VECTOR (1)
def_bool CONFIG_TEST_VECTOR 1 (1)
config CONFIG_HAVE_UDEV bool
def_bool CONFIG_HAVE_UDEV 0 (1)
config CONFIG_FLOW_NODE_TYPE_PIEZO_SPEAKER bool
prompt CONFIG_FLOW_NODE_TYPE_PIEZO_SPEAKER (CONFIG_FLOW)
def_bool CONFIG_FLOW_NODE_TYPE_PIEZO_SPEAKER 1 (CONFIG_FLOW)
config CONFIG_TEST_STR_SPLIT bool
prompt CONFIG_TEST_STR_SPLIT (1)
def_bool CONFIG_TEST_STR_SPLIT 1 (1)
config CONFIG_FBP_TO_DOT bool
prompt CONFIG_FBP_TO_DOT (CONFIG_SOCKET_LINUX and CONFIG_RESOLVER_CONFFILE and CONFIG_INSPECTOR)
def_bool CONFIG_FBP_TO_DOT 1 (CONFIG_SOCKET_LINUX and CONFIG_RESOLVER_CONFFILE and CONFIG_INSPECTOR)
config CONFIG_TEST_STR_SLICE bool
prompt CONFIG_TEST_STR_SLICE (1)
def_bool CONFIG_TEST_STR_SLICE 1 (1)
config CONFIG_HAVE_DECL_STRNDUPA bool
def_bool CONFIG_HAVE_DECL_STRNDUPA 0 (1)
config CONFIG_MAINLOOP_GLIB bool
prompt CONFIG_MAINLOOP_GLIB (1 and (CONFIG_PLATFORM_LINUX_MICRO or CONFIG_PLATFORM_SYSTEMD) and CONFIG_HAVE_GLIB)
config CONFIG_RESOLVER_CONFFILE bool
prompt CONFIG_RESOLVER_CONFFILE (1)
def_bool CONFIG_RESOLVER_CONFFILE 1 (1)
config CONFIG_FLOW_NODE_TYPE_FILTER_REPEATED bool
prompt CONFIG_FLOW_NODE_TYPE_FILTER_REPEATED (CONFIG_FLOW)
def_bool CONFIG_FLOW_NODE_TYPE_FILTER_REPEATED 1 (CONFIG_FLOW)
config CONFIG_LINUX_MICRO_SYSCTL bool
prompt CONFIG_LINUX_MICRO_SYSCTL (CONFIG_LINUX_MICRO)
def_bool CONFIG_LINUX_MICRO_SYSCTL 0 (CONFIG_LINUX_MICRO)
config CONFIG_HAVE_ACCEPT4 bool
def_bool CONFIG_HAVE_ACCEPT4 0 (1)
config CONFIG_FLOW_NODE_TYPE_EVDEV bool
prompt CONFIG_FLOW_NODE_TYPE_EVDEV (CONFIG_FLOW)
def_bool CONFIG_FLOW_NODE_TYPE_EVDEV 1 (CONFIG_FLOW)
config CONFIG_FBP_RUNNER bool
prompt CONFIG_FBP_RUNNER (CONFIG_SOCKET_LINUX and CONFIG_FLOW and CONFIG_RESOLVER_CONFFILE and CONFIG_INSPECTOR)
def_bool CONFIG_FBP_RUNNER 1 (CONFIG_SOCKET_LINUX and CONFIG_FLOW and CONFIG_RESOLVER_CONFFILE and CONFIG_INSPECTOR)
config CONFIG_DEFAULT_LOG_LEVEL_INFO bool
prompt CONFIG_DEFAULT_LOG_LEVEL_INFO (1)
config CONFIG_TEST_MAINLOOP bool
prompt CONFIG_TEST_MAINLOOP (1)
def_bool CONFIG_TEST_MAINLOOP 1 (1)
config CONFIG_FLOW_NODE_TYPE_PROCESS bool
prompt CONFIG_FLOW_NODE_TYPE_PROCESS (CONFIG_FLOW and CONFIG_SOL_PLATFORM_LINUX)
def_bool CONFIG_FLOW_NODE_TYPE_PROCESS 1 (CONFIG_FLOW and CONFIG_SOL_PLATFORM_LINUX)
config CONFIG_TEST_MONITORS bool
prompt CONFIG_TEST_MONITORS (1)
def_bool CONFIG_TEST_MONITORS 1 (1)
config CONFIG_FLOW_NODE_TYPE_TRIGONOMETRY bool
prompt CONFIG_FLOW_NODE_TYPE_TRIGONOMETRY (CONFIG_FLOW)
def_bool CONFIG_FLOW_NODE_TYPE_TRIGONOMETRY 1 (CONFIG_FLOW)
config CONFIG_COAP bool
prompt CONFIG_COAP (1)
def_bool CONFIG_COAP 1 (1)
config CONFIG_LINUX_MICRO_WATCHDOG bool
prompt CONFIG_LINUX_MICRO_WATCHDOG (CONFIG_LINUX_MICRO)
def_bool CONFIG_LINUX_MICRO_WATCHDOG 0 (CONFIG_LINUX_MICRO)
config CONFIG_FLOW_NODE_TYPE_CONSOLE bool
prompt CONFIG_FLOW_NODE_TYPE_CONSOLE (CONFIG_FLOW)
def_bool CONFIG_FLOW_NODE_TYPE_CONSOLE 1 (CONFIG_FLOW)
config CONFIG_LINUX_MICRO_RC_D bool
prompt CONFIG_LINUX_MICRO_RC_D (CONFIG_LINUX_MICRO)
def_bool CONFIG_LINUX_MICRO_RC_D 0 (CONFIG_LINUX_MICRO)
config CONFIG_HAVE_GLIB bool
def_bool CONFIG_HAVE_GLIB 1 (1)
config CONFIG_TEST_STR_TABLE bool
prompt CONFIG_TEST_STR_TABLE (1)
def_bool CONFIG_TEST_STR_TABLE 1 (1)
config CONFIG_USE_CHECK bool
def_bool CONFIG_USE_CHECK 1 (1)
config CONFIG_HAVE_STRING_H bool
def_bool CONFIG_HAVE_STRING_H 0 (1)
config CONFIG_FLOW_NODE_TYPE_FILE bool
prompt CONFIG_FLOW_NODE_TYPE_FILE (CONFIG_FLOW and CONFIG_PTHREAD)
def_bool CONFIG_FLOW_NODE_TYPE_FILE 1 (CONFIG_FLOW and CONFIG_PTHREAD)
config CONFIG_TEST_COAP bool
prompt CONFIG_TEST_COAP (CONFIG_COAP)
def_bool CONFIG_TEST_COAP 1 (CONFIG_COAP)
config CONFIG_FLOW_NODE_TYPE_UNIX_SOCKET bool
prompt CONFIG_FLOW_NODE_TYPE_UNIX_SOCKET (CONFIG_FLOW)
def_bool CONFIG_FLOW_NODE_TYPE_UNIX_SOCKET 1 (CONFIG_FLOW)
config CONFIG_HAVE_DECL_IFLA_INET6_ADDR_GEN_MODE bool
def_bool CONFIG_HAVE_DECL_IFLA_INET6_ADDR_GEN_MODE 0 (1)
config CONFIG_FLOW_NODE_TYPE_COLOR bool
prompt CONFIG_FLOW_NODE_TYPE_COLOR (CONFIG_FLOW)
def_bool CONFIG_FLOW_NODE_TYPE_COLOR 1 (CONFIG_FLOW)
config CONFIG_DEFAULT_LOG_LEVEL_DEBUG bool
prompt CONFIG_DEFAULT_LOG_LEVEL_DEBUG (1)
config CONFIG_LINUX_MICRO_DBUS bool
prompt CONFIG_LINUX_MICRO_DBUS (CONFIG_LINUX_MICRO)
def_bool CONFIG_LINUX_MICRO_DBUS 0 (CONFIG_LINUX_MICRO)
config CONFIG_HAVE_STDINT_H bool
def_bool CONFIG_HAVE_STDINT_H 0 (1)
config CONFIG_FLOW_RESOLVER bool
prompt CONFIG_FLOW_RESOLVER (1)
def_bool CONFIG_FLOW_RESOLVER 1 (1)
config CONFIG_TEST_FLOW_BUILDER bool
prompt CONFIG_TEST_FLOW_BUILDER (1)
def_bool CONFIG_TEST_FLOW_BUILDER 1 (1)
config CONFIG_TEST_FBP_SCANNER bool
prompt CONFIG_TEST_FBP_SCANNER (1)
def_bool CONFIG_TEST_FBP_SCANNER 1 (1)
config CONFIG_FLOW_NODE_TYPE_BYTE bool
prompt CONFIG_FLOW_NODE_TYPE_BYTE (CONFIG_FLOW)
def_bool CONFIG_FLOW_NODE_TYPE_BYTE 1 (CONFIG_FLOW)
config CONFIG_FLOW_NODE_TYPE_INT bool
prompt CONFIG_FLOW_NODE_TYPE_INT (CONFIG_FLOW)
def_bool CONFIG_FLOW_NODE_TYPE_INT 1 (CONFIG_FLOW)
config CONFIG_HAVE_KDBUS bool
def_bool CONFIG_HAVE_KDBUS 0 (1)
config CONFIG_HAVE_SYS_STAT_H bool
def_bool CONFIG_HAVE_SYS_STAT_H 0 (1)
config CONFIG_FLOW_NODE_TYPE_BOOLEAN bool
prompt CONFIG_FLOW_NODE_TYPE_BOOLEAN (CONFIG_FLOW)
def_bool CONFIG_FLOW_NODE_TYPE_BOOLEAN 1 (CONFIG_FLOW)
config CONFIG_LINUX_MICRO_CONSOLE bool
prompt CONFIG_LINUX_MICRO_CONSOLE (CONFIG_LINUX_MICRO)
def_bool CONFIG_LINUX_MICRO_CONSOLE 0 (CONFIG_LINUX_MICRO)
config CONFIG_FLOW_NODE_TYPE_GYROSCOPE bool
prompt CONFIG_FLOW_NODE_TYPE_GYROSCOPE (CONFIG_FLOW and CONFIG_SOL_PLATFORM_LINUX)
def_bool CONFIG_FLOW_NODE_TYPE_GYROSCOPE 1 (CONFIG_FLOW and CONFIG_SOL_PLATFORM_LINUX)
config CONFIG_PIN_MUX_INTEL_GALILEO_REV_G bool
prompt CONFIG_PIN_MUX_INTEL_GALILEO_REV_G (1)
def_bool CONFIG_PIN_MUX_INTEL_GALILEO_REV_G 1 (1)
config CONFIG_USE_GTK bool
def_bool CONFIG_USE_GTK 0 (1)
config CONFIG_FLOW_NODE_TYPE_GROVE bool
prompt CONFIG_FLOW_NODE_TYPE_GROVE (CONFIG_FLOW)
def_bool CONFIG_FLOW_NODE_TYPE_GROVE 1 (CONFIG_FLOW)
config CONFIG_FBP_GENERATOR bool
prompt CONFIG_FBP_GENERATOR (CONFIG_SOCKET_LINUX and CONFIG_FLOW and CONFIG_RESOLVER_CONFFILE and CONFIG_INSPECTOR)
def_bool CONFIG_FBP_GENERATOR 1 (CONFIG_SOCKET_LINUX and CONFIG_FLOW and CONFIG_RESOLVER_CONFFILE and CONFIG_INSPECTOR)
config CONFIG_PLATFORM_LINUX_MICRO bool
prompt CONFIG_PLATFORM_LINUX_MICRO (1)
config CONFIG_FLOW_NODE_TYPE_PWM bool
prompt CONFIG_FLOW_NODE_TYPE_PWM (CONFIG_FLOW)
def_bool CONFIG_FLOW_NODE_TYPE_PWM 1 (CONFIG_FLOW)
config CONFIG_LOG bool
prompt CONFIG_LOG (1)
def_bool CONFIG_LOG 1 (1)
config CONFIG_PLATFORM_SYSTEMD bool
prompt CONFIG_PLATFORM_SYSTEMD (1 and CONFIG_HAVE_SYSTEMD)
bool_choice CONFIG_DEFAULT_LOG_LEVEL_CRITICAL CONFIG_DEFAULT_LOG_LEVEL_ERROR CONFIG_DEFAULT_LOG_LEVEL_WARNING CONFIG_DEFAULT_LOG_LEVEL_INFO CONFIG_DEFAULT_LOG_LEVEL_DEBUG|(CONFIG_LOG and 1)
bool_choice CONFIG_MAINLOOP_GLIB CONFIG_MAINLOOP_POSIX CONFIG_MAINLOOP_RIOTOS|(1)
bool_choice CONFIG_PLATFORM_DUMMY CONFIG_PLATFORM_LINUX_MICRO CONFIG_PLATFORM_RIOTOS CONFIG_PLATFORM_SYSTEMD|(1)
dep CONFIG_DEFAULT_LOG_LEVEL_CRITICAL (1)
dep CONFIG_LINUX_MICRO_BLUETOOTH (CONFIG_LINUX_MICRO)
dep CONFIG_FLOW_NODE_TYPE_CONVERTER (CONFIG_FLOW)
dep CONFIG_KDBUS ((CONFIG_PLATFORM_LINUX_MICRO or CONFIG_PLATFORM_SYSTEMD) and CONFIG_HAVE_SYSTEMD and CONFIG_HAVE_KDBUS)
rev_dep CONFIG_KDBUS (CONFIG_PLATFORM_SYSTEMD and 1 and CONFIG_HAVE_SYSTEMD)
dep CONFIG_FLOW_NODE_TYPE_UDEV (CONFIG_FLOW)
dep CONFIG_MAINLOOP_RIOTOS (1 and CONFIG_PLATFORM_RIOTOS and CONFIG_HAVE_RIOTOS)
dep CONFIG_FLOW_NODE_TYPE_APP (CONFIG_FLOW)
dep CONFIG_FLOW_NODE_TYPE_FLOAT (CONFIG_FLOW)
dep CONFIG_FLOW_NODE_TYPE_NETWORK (CONFIG_FLOW)
dep CONFIG_LINUX_MICRO_HOSTNAME (CONFIG_LINUX_MICRO)
dep CONFIG_FLOW_NODE_TYPE_KEYBOARD (CONFIG_FLOW)
dep CONFIG_SOCKET_LINUX (CONFIG_PLATFORM_LINUX_MICRO or CONFIG_PLATFORM_SYSTEMD)
dep CONFIG_LINUX_MICRO_FSTAB (CONFIG_LINUX_MICRO)
dep CONFIG_FLOW_NODE_TYPE_ACCELEROMETER (CONFIG_FLOW and CONFIG_SOL_PLATFORM_LINUX)
dep CONFIG_FLOW_NODE_TYPE_TEST (CONFIG_FLOW)
rev_dep CONFIG_USE_GLIB (CONFIG_KDBUS and (CONFIG_PLATFORM_LINUX_MICRO or CONFIG_PLATFORM_SYSTEMD) and CONFIG_HAVE_SYSTEMD and CONFIG_HAVE_KDBUS or CONFIG_RESOLVER_CONFFILE or CONFIG_MAINLOOP_GLIB and 1 and (CONFIG_PLATFORM_LINUX_MICRO or CONFIG_PLATFORM_SYSTEMD) and CONFIG_HAVE_GLIB)
dep CONFIG_TEST_MAINLOOP_THREADS_SOL_RUN (CONFIG_PTHREAD)
dep CONFIG_PLATFORM_RIOTOS (1)
dep CONFIG_MAINLOOP_POSIX (1 and (CONFIG_PLATFORM_LINUX_MICRO or CONFIG_PLATFORM_SYSTEMD))
dep CONFIG_TEST_MAINLOOP_THREADS (CONFIG_PTHREAD)
dep CONFIG_FLOW_NODE_TYPE_GTK (CONFIG_FLOW and CONFIG_HAVE_GTK)
dep CONFIG_LINUX_MICRO_LOCALE (CONFIG_LINUX_MICRO)
dep CONFIG_LINUX_MICRO (CONFIG_PLATFORM_LINUX_MICRO)
dep CONFIG_PREFIX (1)
dep CONFIG_FLOW_NODE_TYPE_FS (CONFIG_FLOW)
dep CONFIG_FLOW_NODE_TYPE_GPIO (CONFIG_FLOW)
dep CONFIG_LINUX_MICRO_NETWORK_UP (CONFIG_LINUX_MICRO)
dep CONFIG_FLOW_NODE_TYPE_CONSTANT (CONFIG_FLOW)
rev_dep CONFIG_USE_SYSTEMD (CONFIG_LOG or CONFIG_PLATFORM_SYSTEMD and 1 and CONFIG_HAVE_SYSTEMD)
dep CONFIG_DEFAULT_LOG_LEVEL_ERROR (1)
dep CONFIG_FLOW_NODE_TYPE_RANDOM (CONFIG_FLOW)
dep CONFIG_FLOW_NODE_TYPE_STRING (CONFIG_FLOW)
dep CONFIG_FLOW_NODE_TYPE_AIO (CONFIG_FLOW)
dep CONFIG_FLOW_NODE_TYPE_TIMER (CONFIG_FLOW)
dep CONFIG_TEST_MAINLOOP_LINUX ("PLATFORM_LINUX")
dep CONFIG_FLOW_NODE_TYPE_CALAMARI (CONFIG_FLOW and CONFIG_FLOW_NODE_TYPE_GPIO)
dep CONFIG_PTHREAD (CONFIG_HAVE_PTHREAD and CONFIG_HAVE_GLIB and (CONFIG_PLATFORM_LINUX_MICRO or CONFIG_PLATFORM_SYSTEMD))
dep CONFIG_FLOW_NODE_TYPE_OIC (CONFIG_FLOW and CONFIG_COAP and CONFIG_SOCKET_LINUX)
rev_dep CONFIG_SOL_PLATFORM_LINUX (CONFIG_PLATFORM_DUMMY and 1 or CONFIG_PLATFORM_LINUX_MICRO and 1 or CONFIG_PLATFORM_SYSTEMD and 1 and CONFIG_HAVE_SYSTEMD)
rev_dep CONFIG_ENABLE_DYNAMIC_MODULES (CONFIG_MODULES)
dep CONFIG_FLOW_NODE_TYPE_PLATFORM (CONFIG_FLOW)
dep CONFIG_FLOW_NODE_TYPE_WALLCLOCK (CONFIG_FLOW)
dep CONFIG_FLOW_NODE_TYPE_HUB (CONFIG_FLOW)
dep CONFIG_FLOW_NODE_TYPE_SERVO_MOTOR (CONFIG_FLOW)
dep CONFIG_DEFAULT_LOG_LEVEL_WARNING (1)
dep CONFIG_FLOW_NODE_TYPES (CONFIG_SOCKET_LINUX and CONFIG_RESOLVER_CONFFILE and CONFIG_INSPECTOR)
rev_dep CONFIG_USE_UDEV (CONFIG_FLOW_NODE_TYPE_UDEV and CONFIG_FLOW)
dep CONFIG_PLATFORM_DUMMY (1)
dep CONFIG_FLOW_NODE_TYPE_PIEZO_SPEAKER (CONFIG_FLOW)
dep CONFIG_FBP_TO_DOT (CONFIG_SOCKET_LINUX and CONFIG_RESOLVER_CONFFILE and CONFIG_INSPECTOR)
dep CONFIG_MAINLOOP_GLIB (1 and (CONFIG_PLATFORM_LINUX_MICRO or CONFIG_PLATFORM_SYSTEMD) and CONFIG_HAVE_GLIB)
dep CONFIG_FLOW_NODE_TYPE_FILTER_REPEATED (CONFIG_FLOW)
dep CONFIG_LINUX_MICRO_SYSCTL (CONFIG_LINUX_MICRO)
dep CONFIG_FLOW_NODE_TYPE_EVDEV (CONFIG_FLOW)
dep CONFIG_FBP_RUNNER (CONFIG_SOCKET_LINUX and CONFIG_FLOW and CONFIG_RESOLVER_CONFFILE and CONFIG_INSPECTOR)
dep CONFIG_DEFAULT_LOG_LEVEL_INFO (1)
dep CONFIG_FLOW_NODE_TYPE_PROCESS (CONFIG_FLOW and CONFIG_SOL_PLATFORM_LINUX)
dep CONFIG_FLOW_NODE_TYPE_TRIGONOMETRY (CONFIG_FLOW)
dep CONFIG_LINUX_MICRO_WATCHDOG (CONFIG_LINUX_MICRO)
dep CONFIG_FLOW_NODE_TYPE_CONSOLE (CONFIG_FLOW)
dep CONFIG_LINUX_MICRO_RC_D (CONFIG_LINUX_MICRO)
dep CONFIG_FLOW_NODE_TYPE_FILE (CONFIG_FLOW and CONFIG_PTHREAD)
dep CONFIG_TEST_COAP (CONFIG_COAP)
dep CONFIG_FLOW_NODE_TYPE_UNIX_SOCKET (CONFIG_FLOW)
dep CONFIG_FLOW_NODE_TYPE_COLOR (CONFIG_FLOW)
dep CONFIG_DEFAULT_LOG_LEVEL_DEBUG (1)
dep CONFIG_LINUX_MICRO_DBUS (CONFIG_LINUX_MICRO)
dep CONFIG_FLOW_NODE_TYPE_BYTE (CONFIG_FLOW)
dep CONFIG_FLOW_NODE_TYPE_INT (CONFIG_FLOW)
dep CONFIG_FLOW_NODE_TYPE_BOOLEAN (CONFIG_FLOW)
dep CONFIG_LINUX_MICRO_CONSOLE (CONFIG_LINUX_MICRO)
dep CONFIG_FLOW_NODE_TYPE_GYROSCOPE (CONFIG_FLOW and CONFIG_SOL_PLATFORM_LINUX)
rev_dep CONFIG_USE_GTK (CONFIG_FLOW_NODE_TYPE_GTK and CONFIG_FLOW and CONFIG_HAVE_GTK)
dep CONFIG_FLOW_NODE_TYPE_GROVE (CONFIG_FLOW)
dep CONFIG_FBP_GENERATOR (CONFIG_SOCKET_LINUX and CONFIG_FLOW and CONFIG_RESOLVER_CONFFILE and CONFIG_INSPECTOR)
dep CONFIG_PLATFORM_LINUX_MICRO (1)
dep CONFIG_FLOW_NODE_TYPE_PWM (CONFIG_FLOW)
dep CONFIG_PLATFORM_SYSTEMD (1 and CONFIG_HAVE_SYSTEMD)
```
